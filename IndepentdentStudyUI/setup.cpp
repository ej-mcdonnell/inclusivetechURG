

/*
 * setup.cpp -- part of the IndepentdentStudyUI project.
 * Setup of SerialUI and menu system
 * Emma McDonnell
 * Northwestern University https://github.com/ej-mcdonnell
 * 
 * Copyright (C) 2017 Emma McDonnell
 * 
 * Generated by DruidBuilder [https://devicedruid.com/], 
 * as part of project "ba95b28a789c481fb331c26c854e8d00M1JIfoUoZr",
 * aka IndepentdentStudyUI.
 * 
 * Druid4Arduino, Device Druid, Druid Builder, the builder 
 * code brewery and its wizards, SerialUI and supporting 
 * libraries, as well as the generated parts of this program 
 * are 
 *            Copyright (C) 2013-2017 Pat Deegan 
 * [http://psychogenic.com/ | http://flyingcarsandstuff.com/]
 * and distributed under the terms of their respective licenses.
 * See http://devicedruid.com for details.
 * 
 * 
 * This program is distributed in the hope that it will be useful,
 * but WITHOUT ANY WARRANTY; without even the implied warranty of
 * MERCHANTABILITY or FITNESS FOR A PARTICULAR PURPOSE. 
 * THE ENTIRE RISK AS TO THE QUALITY AND PERFORMANCE OF THE 
 * PROGRAM IS WITH YOU. SHOULD THE PROGRAM PROVE DEFECTIVE, 
 * YOU ASSUME THE COST OF ALL NECESSARY SERVICING, REPAIR OR
 * CORRECTION.
 * 
 * Keep in mind that there is no warranty and you are solely 
 * responsible for the use of all these cool tools.
 * 
 * Play safe, have fun.
 * 
 */


/* we need the SerialUI lib */
#include <SerialUI.h>
#include "IndepentdentStudyUISettings.h"

/* our project specific types and functions are here */
#include "IndepentdentStudyUI.h"



/* MySUI
 * Our SerialUI Instance, through which we can send/receive
 * data from users. Actually instantiated here, for global use.
 */
SUI::SerialUI MySUI(5);


/*
 * The container for MyInputs, which
 * holds all the variables for the various inputs.
 * Actually instantiated here, for global use.
 */
MyInputsContainerSt MyInputs;


/* MyTracked
 * A structure to hold the tracked variables, which will 
 * automatically update the druid UI when modified by this 
 * program.
 * Actually instantiated here, for global use.
 */
MyTrackedVarsContainerSt MyTracked;






bool SetupSerialUI() {

	MySUI.setGreeting(F(serial_ui_greeting_str));
	// SerialUI acts just like (is actually a facade for)
	// Serial.  Use _it_, rather than Serial, throughout the
	// program.
	// basic setup of SerialUI:
	MySUI.begin(serial_baud_rate); // serial line open/setup
	MySUI.setTimeout(serial_readtimeout_ms);   // timeout for reads (in ms), same as for Serial.
	MySUI.setMaxIdleMs(serial_maxidle_ms);    // timeout for user (in ms)
	// how we are marking the "end-of-line" (\n, by default):
	MySUI.setReadTerminator(serial_input_terminator);
	// project UID -- will be used to remember state in Druid...
	MySUI.setUID(SUI_STR("ba95b28a789c481fb331c26c854e8d00M1JIfoUoZr"));

	
	
	
	// Add variable state tracking 
	
	MySUI.trackState(
		SUI_STR("Strength1"),
		&(MyTracked.Strength1));
	
	MySUI.trackState(
		SUI_STR("Pattern1"),
		&(MyTracked.Pattern1));
	
	MySUI.trackState(
		SUI_STR("Motor2On"),
		&(MyTracked.Motor2On));
	
	MySUI.trackState(
		SUI_STR("Strength2"),
		&(MyTracked.Strength2));
	
	MySUI.trackState(
		SUI_STR("Motor1On"),
		&(MyTracked.Motor1On));
	
	MySUI.trackState(
		SUI_STR("Pattern2"),
		&(MyTracked.Pattern2));
	
	
	
	// a few error messages we hopefully won't need
	
	SUI_FLASHSTRING CouldntAddItemErr = F("Could not add item?");
	
	// get top level menu, to start adding items
	SUI::Menu * topMenu = MySUI.topLevelMenu();
	if (! topMenu ) {
		// well, that can't be good...
		MySUI.returnError(F("Very badness in sEriALui!1"));
		return false;
	}
	
	
	
	/* *** Main Menu *** */

	
	if( ! topMenu->addRequest(
		&(MyInputs.MotorNumber),
		SUI_STR("Motor Number"),
		NULL,
		SUI_STR("11"),
		SUI_STR("10"),
		SUI_STR("9"),
		SUI_STR("6"),
		SUI_STR("5"),
		SUI_STR("4"),
		MainMenu::MotorNumberChanged)) {
		MySUI.returnError(CouldntAddItemErr);
		return false;
	}
	
	if( ! topMenu->addRequest(
		&(MyInputs.MotorOn),
		SUI_STR("Motor On"),
		NULL,
		MainMenu::MotorOnChanged)) {
		MySUI.returnError(CouldntAddItemErr);
		return false;
	}
	
	if( ! topMenu->addRequest(
		&(MyInputs.MotorIntensity),
		SUI_STR("MotorIntensity"),
		NULL,
		0,
		255,
		MainMenu::MotorIntensityChanged)) {
		MySUI.returnError(CouldntAddItemErr);
		return false;
	}
	
	if( ! topMenu->addRequest(
		&(MyInputs.MotorPattern),
		SUI_STR("Motor Pattern"),
		NULL,
		SUI_STR("AO"),
		SUI_STR("QP"),
		SUI_STR("SP"),
		SUI_STR("II"),
		SUI_STR("FI"),
		MainMenu::MotorPatternChanged)) {
		MySUI.returnError(CouldntAddItemErr);
		return false;
	}
	
	if( ! topMenu->addCommand(
		SUI_STR("Go"),
		MainMenu::doGo)) {
		MySUI.returnError(CouldntAddItemErr);
		return false;
	}

	
	
	
	return true;
	
}


